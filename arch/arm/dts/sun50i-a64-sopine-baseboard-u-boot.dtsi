// SPDX-License-Identifier: GPL-2.0+
/*
 * Copyright (C) 2018 Jagan Teki <jagan@amarulasolutions.com>
 */

/ {
	aliases {
		spi0 = &spi0;
	};
};

&spi0  {
	flash@0 {
		compatible = "spi-flash";
	};
};

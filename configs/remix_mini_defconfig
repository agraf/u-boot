## configs/remix_mini_defconfig
```kconfig
CONFIG_ARM64=y
CONFIG_ARCH_SUNXI=y
CONFIG_MACH_SUN50I=y
CONFIG_DRAM_CLK=672
CONFIG_DRAM_ZQ=4013533
# CONFIG_VIDEO is not set
CONFIG_DEFAULT_DEVICE_TREE="remix_mini_pc"
# CONFIG_SYS_MALLOC_CLEAR_ON_INIT is not set
CONFIG_SPL=y
# CONFIG_CMD_IMLS is not set
# CONFIG_CMD_FLASH is not set
# CONFIG_CMD_FPGA is not set
CONFIG_CMD_GPIO=y
CONFIG_SYS_DRAM_TEST=y
CONFIG_MMC_SUNXI_SLOT_EXTRA=2
CONFIG_MMC2_PINS="PC"
CONFIG_NON_SECURE=y
```
